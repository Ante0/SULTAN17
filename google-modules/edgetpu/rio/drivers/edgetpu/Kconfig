## google-modules/edgetpu/rio/drivers/edgetpu/Kconfig
```kconfig
menu "EdgeTPU devices"

config EDGETPU_FRAMEWORK
	tristate "EdgeTPU framework"
	depends on ARM64
	select DMA_SHARED_BUFFER
	select GENERIC_ALLOCATOR
	select IOMMU_API
	select SYNC_FILE
	help
	  This framework supports the Edge TPU Machine Learning accelerator
	  devices included in various Google SoCs.

config RIO
	tristate "Rio ML accelerator device driver"
	depends on EDGETPU_FRAMEWORK
	select PM
	help
	  This driver supports the Rio device.  Say Y if you want to include
	  this driver in the kernel.

	  To compile this driver as a module, choose M here.  The module
	  will be called "rio".

config EDGETPU_FUZZ
	bool "Build EdgeTPU driver for fuzz testing"
	depends on EDGETPU_FRAMEWORK
	default n
	help
	  Enable this option to build the EdgeTPU driver with additional
	  functionality specifically designed for fuzz testing.

	  When this flag is enabled, certain security checks may be disabled.
	  This flag should only be enabled for development and testing purposes
	  and must never be enabled in production kernels.

endmenu
```

## google-modules/wlan/wlan_ptracker/Kconfig
```kconfig
# SPDX-License-Identifier: GPL-2.0-only
#
# WiFi Performance Tracker Driver
#

config WLAN_TRACKER
		tristate "WiFi performance tracker driver"
		help
		  Module for wlan performance tracker.
```
